## components/forge_core/Kconfig
```kconfig
menu "espforge core"

    config FORGE_DIAG_TASK_STATS
        bool "diag: per-task CPU and stack statistics at each report"
        default y
        help
            The "diag: tasks" and "diag: cpu" lines. They come from uxTaskGetSystemState(), which measures every task's
            stack with interrupts off: ~6 ms with 25 tasks on an ESP32-P4. A display whose driver restarts each frame
            from an interrupt (ESP-IDF's MIPI-DSI DPI panel: ~0.9 ms between frames) then misses a frame now and then
            and flashes white: turn this off there (MeteoBus's P4 port, October 2026; docs/LESSONS.md L201).

    config FORGE_DIAG_PSRAM_LARGEST
        bool "diag: PSRAM's largest free block in the heap line"
        default y
        help
            heap_caps_get_largest_free_block(MALLOC_CAP_SPIRAM) walks the whole PSRAM heap with interrupts off: ~2.3 ms
            with 32 MB. Off, the heap line keeps PSRAM's free size and minimum and prints "largest -" instead. Same
            reason as FORGE_DIAG_TASK_STATS. The starting log line "diag: stats cost" times both on this board.

endmenu
```

## components/forge_lvgl/Kconfig
```kconfig
menu "espforge LVGL"

    config FORGE_SLIDE_DRAG_PX
        int "slide.c: how far a press moves before it is a pager drag (px)"
        range 6 60
        default 10
        help
            A press on a screen with a slide pager (slide_pager) becomes a drag of the pager once the finger has moved
            this far along the larger axis. 10 is LVGL's own scroll threshold. A larger value keeps a tap or a hold
            with a slight finger move from becoming a swipe (esp32-s3-colormesh takes 28), at the cost of a drag that
            starts later. List scrolls drawn by slide.c still start after 10 px (fewer if this is less), and LVGL's
            own scroll limit is set 10 px past whichever of the two applies to the press (LESSONS L99).

endmenu
```

## components/forge_net/Kconfig
```kconfig
menu "espforge"

    config FORGE_HTTPS_PORT
        int "Settings page HTTPS port"
        default 443
        range 1 65535
        help
            The settings page's port on the home network. 443 normally. A board whose Wi-Fi is a co-processor running
            esp-hosted with "network split" (an ESP32-P4 with an ESP32-C6) hands the host only some ports: 49152-61439
            and a static list that an older co-processor firmware may not give 443 (the Guition JC1060P470C: the page
            was unreachable). Every address the firmware writes (QR codes, redirects, the log) carries the port when it
            is not 443; the PC tools read forge.json's https_port.

    config FORGE_SETUP_SSID
        string "Setup network name"
        default "Forge-Setup"
        help
            Name of the access point the device opens for Wi-Fi setup (captive portal). Same as setup_ssid in
            forge.json (tools/harness joins it from the PC).

    config FORGE_TLS_NAME
        string "Name in the HTTPS certificate"
        default "espforge device"
        help
            Common name of the per-device self-signed certificate, followed by the last 3 bytes of the MAC.

    config FORGE_REPO
        string "GitHub repository (owner/name)"
        default "TheMonkeyz/espforge"
        help
            Used in the User-Agent of the firmware's own HTTP requests.

    config FORGE_PRODUCT
        string "Product name (User-Agent, certificate)"
        default ""
        help
            The name in the User-Agent of the firmware's own requests ("<product>/<version> (...)") and in the
            certificate's organisation (O=). Empty: the ESP-IDF project name.

    config FORGE_UA_COMMENT
        string "User-Agent comment"
        default ""
        help
            Optional words before the repository link: "<product>/<version> (<comment>; +https://github.com/...)".
            Public APIs (OpenStreetMap's tile policy) ask apps to say what they are.

    config FORGE_PORTAL_NAME
        string "Name in the captive portal's link"
        default ""
        help
            The setup network's sign-in page links to the settings page as "<name> setup". Empty: the ESP-IDF
            project name.

endmenu
```

## components/forge_ota/Kconfig
```kconfig
menu "espforge updates"

    config FORGE_OTA_SITE
        string "Update site (GitHub Pages URL, ending with /)"
        default "https://themonkeyz.github.io/espforge/"
        help
            Where channels.json, <channel>/manifest.json and notes.json live (tools/make_flasher_site.py, CI).
            Same as ota_site in forge.json. Devices poll this address: never rename the repository or account.

endmenu
```

## main/Kconfig.projbuild
```kconfig
menu "Starter app"

    config APP_TZ
        string "Time zone (POSIX TZ string)"
        default "EST5EDT,M3.2.0,M11.1.0"
        help
            The clock's local time, e.g. "EST5EDT,M3.2.0,M11.1.0" (Montréal, Toronto, New York) or
            "CET-1CEST,M3.5.0,M10.5.0/3" (Paris). A real app would take it from its settings or a web service.

endmenu
```
